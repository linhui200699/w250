## kernel-4.4/drivers/misc/mediatek/digit_mic/Kconfig
```kconfig
config BIDE_DIGIT_MIC
	bool "BIDE_DIGIT_MIC"
	help
	  BIDE_DIGIT_MIC

source "drivers/misc/mediatek/digit_mic/ac108/Kconfig"
```

## kernel-4.4/drivers/misc/mediatek/sensors-1.0/heart_rate_sensor/Kconfig
```kconfig
config CUSTOM_KERNEL_HEART_RATE_SENSOR
	bool "CUSTOM_KERNEL_HEART_RATE_SENSOR"
	help
	  Kernel space heart rate sensor driver.
          A heart rate monitor is a personal monitoring device
          that allows one to measure one's heart rate in real
          time or record the heart rate for later study.

source "drivers/misc/mediatek/sensors-1.0/heart_rate_sensor/em7028/Kconfig"
```

## kernel-4.4/drivers/misc/mediatek/sensors-1.0/heart_rate_sensor/em7028/Kconfig
```kconfig
config MTK_HEART_EM7028
	bool "MTK_HEART_EM7028 for MediaTek package"
	default n
	help
	  It support different heart rate sensor.
          If this option is set,
```
